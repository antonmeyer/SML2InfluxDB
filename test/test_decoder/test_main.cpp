// Regression test of the SML decoder (src/MeterData.h) with frames captured from real meters.
// Run on the host:  pio test -e native
//
// Important: the frames carry NO wall clock time. The only time information is the meter's own
// sensor time (actSensorTime, seconds counter) in each GetListResponse, so the tests use that.
// The expected values were read from the captures with an independent decoder (libsml dump
// and a python CRC check) and are kept here as literals.
#include <unity.h>
#include <math.h>
#include <string.h>
#include "MeterData.h"
#include "sml_vectors.h"
#include "sml_synth.h" // generated by test/tools/sml_gen.py
#include "otaversion.h"
#include "SampleAggregator.h"
#include "replay_frames.h" // all captured frames, from tools/selftest

#define BUF_SIZE_FOR_TEST 1024 // BUF_SIZE of PowerMeter.h

void setUp() {}
void tearDown() {}

static const SmlVector &vec(const char *name)
{
    for (size_t i = 0; i < sizeof(smlVectors) / sizeof(smlVectors[0]); i++)
        if (strcmp(smlVectors[i].name, name) == 0)
            return smlVectors[i];
    TEST_FAIL_MESSAGE("unknown test vector");
    return smlVectors[0];
}

static MeterDataSet decode(const char *name)
{
    MeterDataSet ds;
    const SmlVector &v = vec(name);
    TEST_ASSERT_EQUAL_MESSAGE(SML_FRAME_OK, smlDecodeFrame(v.data, v.len, ds), name);
    return ds;
}

// ---- every captured frame must decode, with a plausible content -----------------------------

void test_all_vectors_decode()
{
    for (size_t i = 0; i < sizeof(smlVectors) / sizeof(smlVectors[0]); i++)
    {
        MeterDataSet ds;
        TEST_ASSERT_EQUAL_MESSAGE(SML_FRAME_OK, smlDecodeFrame(smlVectors[i].data, smlVectors[i].len, ds),
                                  smlVectors[i].name);
        TEST_ASSERT_TRUE_MESSAGE(ds.hasSumWh, smlVectors[i].name);
        TEST_ASSERT_TRUE_MESSAGE(ds.hasSensorTime, smlVectors[i].name);
        TEST_ASSERT_TRUE_MESSAGE(strlen(ds.meterid) > 3, smlVectors[i].name);
    }
}

// ---- new Landis+Gyr meter (GHWP, 2026): other OBIS codes, no actual power ----------------------

void test_lgz_ids_and_values()
{
    MeterDataSet ds = decode("GHWP_LGZ_0");
    TEST_ASSERT_EQUAL_STRING("LGZ0a014c475a0004370688", ds.meterid);
    TEST_ASSERT_EQUAL_STRING("GHWP", ds.getalias());
    TEST_ASSERT_TRUE(ds.hasSumWh);
    TEST_ASSERT_DOUBLE_WITHIN(0.01, 478000.9, ds.sumWh); // 1-0:1.8.0, 0.1 Wh resolution
    TEST_ASSERT_TRUE(ds.hasExpWh);
    TEST_ASSERT_DOUBLE_WITHIN(0.01, 0.0, ds.expWh); // 1-0:2.8.0
    TEST_ASSERT_EQUAL_UINT32(8775977, ds.sensorTime);
}

void test_lgz_has_no_actual_power()
{
    // The meter sends no 1-0:16.7.0 (needs the PIN on the meter). The decoder must say so
    // instead of reporting 0 W.
    MeterDataSet ds = decode("GHWP_LGZ_0");
    TEST_ASSERT_FALSE(ds.hasActW);
}

// ---- Iskra (GHHS): the "old" format ------------------------------------------------------------

void test_iskra_ids_and_values()
{
    MeterDataSet ds = decode("GHHS_ISK_0");
    TEST_ASSERT_EQUAL_STRING("ISK090149534b000421d3d9", ds.meterid);
    TEST_ASSERT_EQUAL_STRING("GHHS", ds.getalias());
    TEST_ASSERT_TRUE(ds.hasActW);
    TEST_ASSERT_DOUBLE_WITHIN(0.01, 429.0, ds.actW);
    TEST_ASSERT_TRUE(ds.hasSumWh);
    TEST_ASSERT_DOUBLE_WITHIN(0.01, 16735141.4, ds.sumWh);
    TEST_ASSERT_FALSE(ds.hasExpWh); // no 2.8.0 on this meter
    TEST_ASSERT_EQUAL_UINT32(280160085, ds.sensorTime);
}

// ---- EMH --------------------------------------------------------------------------------------

void test_emh_ids_and_values()
{
    MeterDataSet ds = decode("EMH_0");
    TEST_ASSERT_EQUAL_STRING("EMH01a815133577030102", ds.meterid);
    TEST_ASSERT_EQUAL_STRING("Loewe", ds.getalias());
    TEST_ASSERT_TRUE(ds.hasActW);
    TEST_ASSERT_DOUBLE_WITHIN(0.01, 0.0, ds.actW);
    TEST_ASSERT_DOUBLE_WITHIN(0.01, 5598064.7, ds.sumWh);
    TEST_ASSERT_EQUAL_UINT32(202264802, ds.sensorTime);

    MeterDataSet old = decode("EMH_2019_0");
    TEST_ASSERT_EQUAL_STRING("EMH01a815133577030102", old.meterid);
    TEST_ASSERT_DOUBLE_WITHIN(0.01, 5598063.4, old.sumWh);
    TEST_ASSERT_EQUAL_UINT32(202207280, old.sensorTime);
}

// ---- time and energy between frames -----------------------------------------------------------

void test_consecutive_frames_sensor_time_and_energy()
{
    const char *seq[][2] = {{"GHWP_LGZ_0", "GHWP_LGZ_1"}, {"GHHS_ISK_0", "GHHS_ISK_1"}, {"EMH_0", "EMH_1"}};
    for (auto &p : seq)
    {
        MeterDataSet a = decode(p[0]), b = decode(p[1]);
        TEST_ASSERT_EQUAL_STRING(a.meterid, b.meterid);
        TEST_ASSERT_TRUE_MESSAGE(b.sensorTime > a.sensorTime, p[0]);
        TEST_ASSERT_TRUE_MESSAGE(b.sensorTime - a.sensorTime <= 5, p[0]); // one frame per 1..2 s
        TEST_ASSERT_TRUE_MESSAGE(b.sumWh >= a.sumWh, p[0]);               // energy counter never goes back
    }
}

void test_sensor_time_is_seconds_cross_check_with_actual_power()
{
    // Iskra delivers the actual power AND the energy: the mean power calculated from the energy
    // delta and the sensor time delta must be close to the reported power. This shows that the
    // sensor time is a seconds counter. The same calculation works for the LGZ without 16.7.0.
    MeterDataSet a = decode("GHHS_ISK_0"), b = decode("GHHS_ISK_58");
    double dt = (double)(b.sensorTime - a.sensorTime);
    TEST_ASSERT_DOUBLE_WITHIN(1.0, 97.0, dt);
    double pmean = (b.sumWh - a.sumWh) * 3600.0 / dt;
    TEST_ASSERT_DOUBLE_WITHIN(0.05 * a.actW, a.actW, pmean);
}

void test_lgz_power_from_energy_delta()
{
    // 0.1 Wh resolution over ~4.5 min: coarse but plausible (standby of the heat pump)
    MeterDataSet a = decode("GHWP_LGZ_0"), b = decode("GHWP_LGZ_275");
    double dt = (double)(b.sensorTime - a.sensorTime);
    TEST_ASSERT_DOUBLE_WITHIN(0.5, 276.0, dt); // 8775977 -> 8776253
    double pmean = (b.sumWh - a.sumWh) * 3600.0 / dt;
    TEST_ASSERT_TRUE(pmean > 1.0 && pmean < 15.0);
}

// ---- robustness: damaged frames must be rejected, never decoded to wrong values ---------------

void test_bad_crc_is_rejected()
{
    const SmlVector &v = vec("GHHS_ISK_0");
    uint8_t buf[512];
    TEST_ASSERT_TRUE(v.len <= sizeof(buf));
    memcpy(buf, v.data, v.len);
    buf[40] ^= 0x01; // one bit in the payload
    MeterDataSet ds;
    TEST_ASSERT_EQUAL(SML_FRAME_BAD_CRC, smlDecodeFrame(buf, v.len, ds));
    TEST_ASSERT_FALSE(ds.hasData());
}

void test_truncated_and_foreign_frames()
{
    const SmlVector &v = vec("GHWP_LGZ_0");
    MeterDataSet ds;
    TEST_ASSERT_EQUAL(SML_FRAME_TOO_SHORT, smlDecodeFrame(v.data, 10, ds));
    TEST_ASSERT_EQUAL(SML_FRAME_NO_END, smlDecodeFrame(v.data, v.len - 3, ds));
    TEST_ASSERT_EQUAL(SML_FRAME_NO_START, smlDecodeFrame(v.data + 4, v.len - 4, ds));
}

void test_decoder_does_not_keep_old_values()
{
    // values of the previous frame must not leak into the next one (hasActW from Iskra, then LGZ)
    MeterDataSet ds;
    const SmlVector &a = vec("GHHS_ISK_0"), &b = vec("GHWP_LGZ_0");
    TEST_ASSERT_EQUAL(SML_FRAME_OK, smlDecodeFrame(a.data, a.len, ds));
    TEST_ASSERT_TRUE(ds.hasActW);
    TEST_ASSERT_EQUAL(SML_FRAME_OK, smlDecodeFrame(b.data, b.len, ds));
    TEST_ASSERT_FALSE(ds.hasActW);
    TEST_ASSERT_EQUAL_STRING("GHWP", ds.getalias());
}

void test_lookup_new_vhwp_meter()
{
    // not captured yet. The label "1 LGZ00 1927 0912" prints the last 4 bytes of the serial as DECIMAL:
    // GHWP: label 7071 5016 == 0x04370688 (verified with the capture), VHWP: 19270912 == 0x01260d00
    TEST_ASSERT_EQUAL_UINT32(0x04370688u, 70715016u);
    TEST_ASSERT_EQUAL_UINT32(0x01260d00u, 19270912u);
    MeterDataSet ds;
    strcpy(ds.meterid, "LGZ0a014c475a0001260d00");
    TEST_ASSERT_EQUAL_STRING("VHWP", ds.getalias());
}

// ---- synthetic frames: variants we have no capture of (generated, with the expected values) ---------

void test_synthetic_frames()
{
    for (size_t i = 0; i < sizeof(synthCases) / sizeof(synthCases[0]); i++)
    {
        const SynthCase &c = synthCases[i];
        MeterDataSet ds;
        TEST_ASSERT_EQUAL_MESSAGE(SML_FRAME_OK, smlDecodeFrame(c.data, c.len, ds), c.name);
        TEST_ASSERT_EQUAL_STRING_MESSAGE(c.meterid, ds.meterid, c.name);
        TEST_ASSERT_EQUAL_MESSAGE(c.hasActW, ds.hasActW, c.name);
        TEST_ASSERT_EQUAL_MESSAGE(c.hasSumWh, ds.hasSumWh, c.name);
        TEST_ASSERT_EQUAL_MESSAGE(c.hasExpWh, ds.hasExpWh, c.name);
        TEST_ASSERT_EQUAL_MESSAGE(c.hasTime, ds.hasSensorTime, c.name);
        if (c.hasActW)
            TEST_ASSERT_DOUBLE_WITHIN_MESSAGE(0.001, c.actW, ds.actW, c.name);
        if (c.hasSumWh)
            TEST_ASSERT_DOUBLE_WITHIN_MESSAGE(0.001, c.sumWh, ds.sumWh, c.name);
        if (c.hasExpWh)
            TEST_ASSERT_DOUBLE_WITHIN_MESSAGE(0.001, c.expWh, ds.expWh, c.name);
        if (c.hasTime)
            TEST_ASSERT_EQUAL_UINT32_MESSAGE(c.sensorTime, ds.sensorTime, c.name);
        TEST_ASSERT_TRUE_MESSAGE(c.len < BUF_SIZE_FOR_TEST, c.name); // must fit the receive buffer of the firmware
    }
}

void test_version_compare()
{
    TEST_ASSERT_TRUE(versionNewer("1.2.0.1", "1.2.0.0"));
    TEST_ASSERT_TRUE(versionNewer("1.10.0.0", "1.9.9.9")); // numbers, not text
    TEST_ASSERT_TRUE(versionNewer("2.0", "1.9.9.9"));
    TEST_ASSERT_FALSE(versionNewer("1.2.0.0", "1.2.0.0")); // same
    TEST_ASSERT_FALSE(versionNewer("1.1.0.1", "1.2.0.0")); // older
    TEST_ASSERT_FALSE(versionNewer("", "1.0.0.0"));        // no version header
    TEST_ASSERT_FALSE(versionNewer("abc", "0.0.0.0"));
    TEST_ASSERT_TRUE(versionNewer("1.0.0.1", "1.0.0"));    // missing parts are 0
}

// ---- SampleAggregator: from 1 frame per second to the points we write -------------------------------------

#define MAXP 128
struct Pts
{
    SamplePoint p[MAXP];
    int n = 0;
    void add(const SamplePoint &x)
    {
        if (n < MAXP)
            p[n++] = x;
    }
};

// frames of one meter from the captures: all replay frames whose name starts with prefix, in order
static int framesOf(const char *prefix, MeterDataSet *out, int max)
{
    int n = 0;
    for (int i = 0; i < REPLAY_COUNT && n < max; i++)
        if (strncmp(replayFrames[i].name, prefix, strlen(prefix)) == 0)
        {
            MeterDataSet ds;
            TEST_ASSERT_EQUAL_MESSAGE(SML_FRAME_OK, smlDecodeFrame(replayFrames[i].data, replayFrames[i].len, ds),
                                      replayFrames[i].name);
            out[n++] = ds;
        }
    return n;
}

static MeterDataSet mk(const char *id, uint32_t t, bool hasW, double w, double sum)
{
    MeterDataSet ds;
    strcpy(ds.meterid, id);
    ds.hasSensorTime = true;
    ds.sensorTime = t;
    ds.hasActW = hasW;
    ds.actW = w;
    ds.hasSumWh = true;
    ds.sumWh = sum;
    return ds;
}

#define EPOCH0 1760000000u // some wall clock

void test_agg_real_iskra_capture()
{
    static MeterDataSet fr[64];
    int n = framesOf("GHHS_ISK_", fr, 64);
    TEST_ASSERT_EQUAL(59, n);
    SampleAggregator agg(5, 30);
    Pts pts;
    for (int i = 0; i < n; i++)
    {
        SamplePoint p;
        if (agg.add(fr[i], EPOCH0 + (fr[i].sensorTime - fr[0].sensorTime), p))
            pts.add(p);
    }
    // 97 s of frames in 5 s windows, the last window is not closed yet
    TEST_ASSERT_INT_WITHIN(1, 19, pts.n);
    int withSum = 0;
    for (int i = 0; i < pts.n; i++)
    {
        const SamplePoint &p = pts.p[i];
        TEST_ASSERT_TRUE(p.hasW);
        TEST_ASSERT_TRUE(p.wMin <= p.wMean && p.wMean <= p.wMax);
        TEST_ASSERT_DOUBLE_WITHIN(5.0, 430.0, p.wMean); // the meter reports 429..432 W in this capture
        withSum += p.hasSumWh;
        if (i > 0)
        {
            TEST_ASSERT_TRUE(p.epoch > pts.p[i - 1].epoch);
            TEST_ASSERT_UINT32_WITHIN(2, 5, p.epoch - pts.p[i - 1].epoch);
            if (p.hasSumWh && pts.p[i - 1].hasSumWh)
                TEST_ASSERT_TRUE(p.sumWh >= pts.p[i - 1].sumWh);
        }
    }
    TEST_ASSERT_TRUE(withSum >= pts.n - 2); // the counter changes in nearly every window
    // time stamps come from the clock of the meter: first point = time of its last frame
    TEST_ASSERT_TRUE(pts.p[0].epoch >= EPOCH0 && pts.p[0].epoch <= EPOCH0 + 6);
    // power from the energy of the points must match the mean of the measured power
    int a = 0, b = pts.n - 1;
    double pe = (pts.p[b].sumWh - pts.p[a].sumWh) * 3600.0 / (double)(pts.p[b].epoch - pts.p[a].epoch);
    double pm = 0;
    for (int i = a; i <= b; i++)
        pm += pts.p[i].wMean;
    pm /= (b - a + 1);
    TEST_ASSERT_DOUBLE_WITHIN(0.04 * pm, pm, pe);
}

void test_agg_real_lgz_capture_without_power()
{
    static MeterDataSet fr[64];
    int n = framesOf("GHWP_LGZ_", fr, 64);
    TEST_ASSERT_EQUAL(60, n);
    SampleAggregator agg(5, 30);
    Pts pts;
    for (int i = 0; i < n; i++)
    {
        SamplePoint p;
        if (agg.add(fr[i], EPOCH0 + i, p))
            pts.add(p);
    }
    // 60 s, the energy hardly changes: first point, then a heartbeat every 30 s, plus the points of changes
    TEST_ASSERT_TRUE(pts.n >= 2 && pts.n <= 6);
    for (int i = 0; i < pts.n; i++)
    {
        TEST_ASSERT_FALSE(pts.p[i].hasW);   // the LGZ sends no power without PIN
        TEST_ASSERT_TRUE(pts.p[i].hasSumWh); // every point exists for a change or heartbeat of the energy
        if (i > 0)
        {
            bool changed = pts.p[i].sumWh != pts.p[i - 1].sumWh;
            bool heartbeat = pts.p[i].epoch - pts.p[i - 1].epoch >= 30;
            TEST_ASSERT_TRUE(changed || heartbeat);
            TEST_ASSERT_TRUE(pts.p[i].epoch - pts.p[i - 1].epoch >= 4); // at most one point per window
        }
    }
}

void test_agg_power_statistics()
{
    SampleAggregator agg(5, 30);
    Pts pts;
    for (uint32_t t = 0; t < 120; t++) // 100 W and 200 W alternate
    {
        SamplePoint p;
        if (agg.add(mk("T1", t, true, (t % 2) ? 200.0 : 100.0, 1000.0 + t * 0.1), EPOCH0 + t, p))
            pts.add(p);
    }
    TEST_ASSERT_INT_WITHIN(1, 23, pts.n);
    for (int i = 0; i < pts.n; i++)
    {
        TEST_ASSERT_EQUAL_DOUBLE(100.0, pts.p[i].wMin);
        TEST_ASSERT_EQUAL_DOUBLE(200.0, pts.p[i].wMax);
        TEST_ASSERT_DOUBLE_WITHIN(10.0, 150.0, pts.p[i].wMean);
    }
}

void test_agg_time_stamps_independent_of_arrival_jitter()
{
    // frames arrive 0..3 s late (loop() was blocked); the points must still be 5 s apart
    static const uint8_t jitter[] = {2, 0, 1, 3, 0, 1, 2, 0, 3, 1, 0, 2, 1, 3, 0};
    SampleAggregator agg(5, 30);
    Pts pts;
    for (uint32_t t = 0; t < 150; t++)
    {
        SamplePoint p;
        if (agg.add(mk("T1", 500 + t, true, 100, 1000.0 + t), EPOCH0 + t + jitter[t % 15], p))
            pts.add(p);
    }
    TEST_ASSERT_TRUE(pts.n > 20);
    for (int i = 2; i < pts.n; i++)
        TEST_ASSERT_EQUAL_UINT32(5, pts.p[i].epoch - pts.p[i - 1].epoch);
}

void test_agg_burst_after_blocked_loop()
{
    // 6 frames come at once (all handled at the same wall clock second)
    SampleAggregator agg(5, 30);
    Pts pts;
    uint32_t now = EPOCH0 + 100;
    for (uint32_t t = 90; t < 96; t++)
    {
        SamplePoint p;
        if (agg.add(mk("T1", t, true, 100, 1000.0 + t), now, p))
            pts.add(p);
    }
    for (uint32_t t = 96; t < 110; t++) // then normal again
    {
        SamplePoint p;
        if (agg.add(mk("T1", t, true, 100, 1000.0 + t), EPOCH0 + 100 + (t - 95), p))
            pts.add(p);
    }
    TEST_ASSERT_TRUE(pts.n >= 2);
    for (int i = 0; i < pts.n; i++)
        TEST_ASSERT_TRUE(pts.p[i].epoch <= now + 20); // never from the future of the frame it describes
    TEST_ASSERT_EQUAL_UINT32(5, pts.p[pts.n - 1].epoch - pts.p[pts.n - 2].epoch);
}

void test_agg_energy_heartbeat_when_nothing_changes()
{
    SampleAggregator agg(5, 30);
    Pts pts;
    for (uint32_t t = 0; t < 100; t++)
    {
        SamplePoint p;
        if (agg.add(mk("T1", t, false, 0, 5000.0), EPOCH0 + t, p))
            pts.add(p);
    }
    TEST_ASSERT_INT_WITHIN(1, 3, pts.n);
    for (int i = 0; i < pts.n; i++)
    {
        TEST_ASSERT_FALSE(pts.p[i].hasW);
        TEST_ASSERT_TRUE(pts.p[i].hasSumWh);
        if (i > 0)
            TEST_ASSERT_TRUE(pts.p[i].epoch - pts.p[i - 1].epoch >= 30);
    }
}

void test_agg_energy_change_is_sent_within_one_window()
{
    SampleAggregator agg(5, 30);
    Pts pts;
    for (uint32_t t = 0; t < 40; t++)
    {
        SamplePoint p;
        double wh = t < 17 ? 5000.0 : 5000.1; // changes once at t = 17
        if (agg.add(mk("T1", t, false, 0, wh), EPOCH0 + t, p))
            pts.add(p);
    }
    // first point (t=4), the change in window 15..19 comes with the window closed at t=20, then nothing until 30 s
    bool found = false;
    for (int i = 0; i < pts.n; i++)
        if (pts.p[i].hasSumWh && pts.p[i].sumWh > 5000.05)
        {
            found = true;
            TEST_ASSERT_TRUE(pts.p[i].epoch <= EPOCH0 + 19);
        }
    TEST_ASSERT_TRUE(found);
}

void test_agg_other_meter_and_time_jump_restart()
{
    SampleAggregator agg(5, 30);
    Pts pts;
    for (uint32_t t = 100; t < 112; t++)
    {
        SamplePoint p;
        if (agg.add(mk("AAA", t, true, 100, 1000.0), EPOCH0 + t, p))
            pts.add(p);
    }
    int before = pts.n;
    for (uint32_t t = 50; t < 62; t++) // another meter with its own clock (and one that is behind)
    {
        SamplePoint p;
        if (agg.add(mk("BBB", t, true, 300, 9000.0), EPOCH0 + 200 + t, p))
            pts.add(p);
    }
    TEST_ASSERT_TRUE(pts.n > before);
    for (int i = before; i < pts.n; i++)
    {
        TEST_ASSERT_DOUBLE_WITHIN(0.01, 300.0, pts.p[i].wMean); // no value of the other meter leaks in
        TEST_ASSERT_TRUE(pts.p[i].epoch >= EPOCH0 + 250);        // new offset, not the one of the first meter
    }
}

void test_agg_without_meter_time_uses_wall_clock()
{
    SampleAggregator agg(5, 30);
    Pts pts;
    for (uint32_t t = 0; t < 30; t++)
    {
        MeterDataSet ds = mk("T1", 0, true, 100, 1000.0 + t);
        ds.hasSensorTime = false;
        SamplePoint p;
        if (agg.add(ds, EPOCH0 + t, p))
            pts.add(p);
    }
    TEST_ASSERT_TRUE(pts.n >= 4);
    TEST_ASSERT_UINT32_WITHIN(1, EPOCH0 + 24, pts.p[pts.n - 1].epoch); // the time of its last frame
}

void test_agg_interval_zero_passes_every_frame()
{
    SampleAggregator agg(0, 30);
    for (uint32_t t = 0; t < 5; t++)
    {
        SamplePoint p;
        TEST_ASSERT_TRUE(agg.add(mk("T1", t, true, 100 + t, 1000.0 + t), EPOCH0 + t, p));
        TEST_ASSERT_TRUE(p.hasW && p.hasSumWh);
        TEST_ASSERT_EQUAL_DOUBLE(100 + t, p.wMean);
        TEST_ASSERT_EQUAL_DOUBLE(p.wMean, p.wMax);
    }
}

void test_alias_fallback()
{
    MeterDataSet ds;
    strcpy(ds.meterid, "XYZ00");
    TEST_ASSERT_EQUAL_STRING("XYZ00", ds.getalias());
    ds.alias = "VHWP";
    TEST_ASSERT_EQUAL_STRING("VHWP", ds.getalias());
}

int main(int, char **)
{
    UNITY_BEGIN();
    RUN_TEST(test_all_vectors_decode);
    RUN_TEST(test_lgz_ids_and_values);
    RUN_TEST(test_lgz_has_no_actual_power);
    RUN_TEST(test_iskra_ids_and_values);
    RUN_TEST(test_emh_ids_and_values);
    RUN_TEST(test_consecutive_frames_sensor_time_and_energy);
    RUN_TEST(test_sensor_time_is_seconds_cross_check_with_actual_power);
    RUN_TEST(test_lgz_power_from_energy_delta);
    RUN_TEST(test_bad_crc_is_rejected);
    RUN_TEST(test_truncated_and_foreign_frames);
    RUN_TEST(test_decoder_does_not_keep_old_values);
    RUN_TEST(test_synthetic_frames);
    RUN_TEST(test_lookup_new_vhwp_meter);
    RUN_TEST(test_version_compare);
    RUN_TEST(test_agg_real_iskra_capture);
    RUN_TEST(test_agg_real_lgz_capture_without_power);
    RUN_TEST(test_agg_power_statistics);
    RUN_TEST(test_agg_time_stamps_independent_of_arrival_jitter);
    RUN_TEST(test_agg_burst_after_blocked_loop);
    RUN_TEST(test_agg_energy_heartbeat_when_nothing_changes);
    RUN_TEST(test_agg_energy_change_is_sent_within_one_window);
    RUN_TEST(test_agg_other_meter_and_time_jump_restart);
    RUN_TEST(test_agg_without_meter_time_uses_wall_clock);
    RUN_TEST(test_agg_interval_zero_passes_every_frame);
    RUN_TEST(test_alias_fallback);
    return UNITY_END();
}
